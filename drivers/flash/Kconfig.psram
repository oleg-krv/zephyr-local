## drivers/flash/Kconfig.psram
```kconfig
# Copyright (c) 2021 Krivorot Oleg <krivorot.oleg@gmail.com>
#
# SPDX-License-Identifier: Apache-2.0

menuconfig SPI_PSRAM
	bool "Pseudo−SRA similar Flash"
	select FLASH_HAS_DRIVER_ENABLED
	#select FLASH_HAS_PAGE_LAYOUT
	depends on SPI

if SPI_PSRAM

config SPI_PSRAM_INIT_PRIORITY
	int
	default 80
	help
	  Device driver initialization priority.
	  Device is connected to SPI bus, it has to
	  be initialized after SPI driver.

config SPI_PSRAM_CS_WAIT_DELAY
	int "Delay time in us"
	default 0
	help
	  This is the wait delay (in us) to allow for CS switching to take effect

config SPI_PSRAM_LAYOUT_PAGE_SIZE
	int "Page size to use for FLASH_LAYOUT feature"
	default 65536
	help
	  When CONFIG_FLASH_PAGE_LAYOUT is used this driver will support
	  that API.  By default the page size corresponds to the block
	  size (65536).  Other options include the 32K-byte erase size
	  (32768), the sector size (4096), or any non-zero multiple of the
	  sector size.

endif # SPI_PSRAM
```

## drivers/sensor/lsm6ds3/Kconfig
```kconfig
# ST Microelectronics LSM6DS3 6-axis IMU sensor driver

# Copyright (c) 2019 STMicroelectronics
# SPDX-License-Identifier: Apache-2.0

menuconfig LSM6DS3
	bool "LSM6DS3 I2C/SPI accelerometer and gyroscope Chip"
	depends on (I2C && HAS_DTS_I2C) || SPI
	select HAS_STMEMSC
	select USE_STDC_LSM6DS3
	help
	  Enable driver for LSM6DS3 accelerometer and gyroscope
	  sensor.

if LSM6DS3

choice LSM6DS3_TRIGGER_MODE
	prompt "Trigger mode"
	help
	  Specify the type of triggering to be used by the driver.

config LSM6DS3_TRIGGER_NONE
	bool "No trigger"

config LSM6DS3_TRIGGER_GLOBAL_THREAD
	bool "Use global thread"
	depends on GPIO
	select LSM6DS3_TRIGGER

config LSM6DS3_TRIGGER_OWN_THREAD
	bool "Use own thread"
	depends on GPIO
	select LSM6DS3_TRIGGER

endchoice

config LSM6DS3_TRIGGER
	bool

if LSM6DS3_TRIGGER

config LSM6DS3_THREAD_PRIORITY
	int "Thread priority"
	depends on LSM6DS3_TRIGGER_OWN_THREAD
	default 10
	help
	  Priority of thread used by the driver to handle interrupts.

config LSM6DS3_THREAD_STACK_SIZE
	int "Thread stack size"
	depends on LSM6DS3_TRIGGER_OWN_THREAD
	default 1024
	help
	  Stack size of thread used by the driver to handle interrupts.

choice LSM6DS3_INT_PIN
	prompt "Sensor INT pin number"
	default LSM6DS3_INT_PIN_1
	help
	  The number of LSM6DS3 int pin used to generate interrupt to cpu.
	  Supported values are int1 or int2

config LSM6DS3_INT_PIN_1
	bool "int1"

config LSM6DS3_INT_PIN_2
	bool "int2"
endchoice

endif # LSM6DS3_TRIGGER

config LSM6DS3_ENABLE_FIFO
	bool "Enable FIFO buffer"
	help
	  Enable/disable FIFO buffer

config LSM6DS3_ENABLE_TEMP
	bool "Enable temperature"
	help
	  Enable/disable temperature

config LSM6DS3_SENSORHUB
	bool "Enable I2C sensorhub feature"
	help
	  Enable/disable internal sensorhub. You can enable
	  a maximum of two external sensors (if more than two are enabled
	  the system would enumerate only the first two found)

if LSM6DS3_SENSORHUB

config LSM6DS3_EXT_LIS2MDL
	bool "Enable LIS2MDL as external sensor"
	default y

config LSM6DS3_EXT_LPS22HH
	bool "Enable LPS22HH as external sensor"
	default y

config LSM6DS3_EXT_HTS221
	bool "Enable HTS221 as external sensor"

config LSM6DS3_EXT_LPS22HB
	bool "Enable LPS22HB as external sensor"

endif # LSM6DS3_SENSORHUB

menu "Attributes"

config LSM6DS3_GYRO_FS
	int "Gyroscope full-scale range"
	default 0
	help
	  Specify the default gyroscope full-scale range.
	  An X value for the config represents a range of +/- X degree per
	  second. Valid values are:
	  0:  Full Scale selected at runtime
	  125:   +/- 125dps
	  250:   +/- 250dps
	  500:   +/- 500dps
	  1000:  +/- 1000dps
	  2000:  +/- 2000dps

config LSM6DS3_GYRO_ODR
	int "Gyroscope Output data rate frequency"
	range 0 10
	default 0
	help
	  Specify the default accelerometer output data rate expressed in
	  samples per second (Hz).
	  0: ODR selected at runtime
	  1: 12.5Hz
	  2: 26Hz
	  3: 52Hz
	  4: 104Hz
	  5: 208Hz
	  6: 416Hz
	  7: 833Hz
	  8: 1660Hz
	  9: 3330Hz
	  10: 6660Hz

config LSM6DS3_ACCEL_FS
	int "Accelerometer full-scale range"
	default 0
	help
	  Specify the default accelerometer full-scale range.
	  An X value for the config represents a range of +/- X G. Valid values
	  are:
	  0:  Full Scale selected at runtime
	  2:  +/- 2g
	  4:  +/- 4g
	  8:  +/- 8g
	  16: +/- 16g

config LSM6DS3_ACCEL_ODR
	int "Accelerometer Output data rate frequency"
	range 0 10
	default 0
	help
	  Specify the default accelerometer output data rate expressed in
	  samples per second (Hz).
	  0: ODR selected at runtime
	  1: 12.5Hz
	  2: 26Hz
	  3: 52Hz
	  4: 104Hz
	  5: 208Hz
	  6: 416Hz
	  7: 833Hz
	  8: 1660Hz
	  9: 3330Hz
	  10: 6660Hz
endmenu

endif # LSM6DS3
```

## dts/bindings/mtd/pseudo,mtd-sram.yaml
```yaml
# Copyright (c) 2021 Krivorot <oleg krivorot.oleg@gmail.com>
# SPDX-License-Identifier: Apache-2.0

description: |
  Properties supporting Zephyr pseudo sram driver (over the Zephyr SPI
  API). Simulate mtd spi device.

compatible: "pseudo,mtd-sram"

include: [spi-device.yaml]

properties:
  mf-id:
    type: uint8-array
    required: true
    description: MF ID.

  size:
    type: int
    required: true
    description: Flash capacity in bits.

  read-not-wait-max-frequency:
    type: int
    required: false
    default: 33000000
    description: Maximum clock frequency of device's SPI interface in Hz for read not wait

  tce-max-time:
    type: int
    required: false
    default: 8
    description: CE low pulse width (μs)
```

## dts/bindings/sensor/st,lsm6ds3-i2c.yaml
```yaml
# Copyright (c) 2019 STMicroelectronics
# SPDX-License-Identifier: Apache-2.0

description: |
    STMicroelectronics LSM6DS3 6-axis IMU (Inertial Measurement Unit) sensor
    accessed through I2C bus

compatible: "st,lsm6ds3"

include: ["i2c-device.yaml", "st,lsm6ds3-common.yaml"]
```

## lib/gui/lvgl/Kconfig
```kconfig
# Copyright (c) 2018-2019 Jan Van Winkel <jan.van_winkel@dxplore.eu>
# Copyright (c) 2020 Teslabs Engineering S.L.
# SPDX-License-Identifier: Apache-2.0

menuconfig LVGL
	bool "LittlevGL GUI library"
	help
	  This option enables the LittlevGL GUI library.

if LVGL

module = LVGL
module-str = lvgl
source "subsys/logging/Kconfig.template.log_config"

config APP_LINK_WITH_LVGL
	bool "Link 'app' with LVGL"
	default y
	help
	  Add LVGL header files to the 'app' include path. It may be
	  disabled if the include paths for LVGL are causing aliasing
	  issues for 'app'.

config LVGL_USE_USER_CONFIG
	bool "Use user config file"
	help
	  Add custom preferences file, for example to enable custom fonts.
	  In the file, you can override all values set by variables from
	  Kconfig or set new ones that cannot be defined using variables
	  from Kconfig.

config LVGL_USER_CONFIG_FILE
	string "User config file name"
	default "lv_conf_user.h"
	depends on LVGL_USE_USER_CONFIG
	help
	  This file should be located in the root folder of the project,
	  or in any folder, the path to which is registered in root
	  CMakeLists.txt using the macro zephyr_include_directories()

rsource "Kconfig.graphical"
rsource "Kconfig.memory"
rsource "Kconfig.input"
rsource "Kconfig.feature"
rsource "Kconfig.image"
rsource "Kconfig.debug"
rsource "Kconfig.themes"
rsource "Kconfig.fonts"
rsource "Kconfig.text"
rsource "Kconfig.objects"

endif # LVGL
```

## soc/arm/st_stm32/stm32f2/Kconfig.defconfig.stm32f205xx
```kconfig
# ST Microelectronics stm32f205 MCU

# Copyright (c) 2018 qianfan Zhao <qianfanguijin@163.com>
# SPDX-License-Identifier: Apache-2.0

if SOC_STM32F205XX

config SOC
	default "STM32F205xx"

config NUM_IRQS
	default 81

endif
```
